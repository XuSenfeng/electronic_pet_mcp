## main/Kconfig.projbuild
```kconfig
menu "Xiaozhi Assistant"

config OTA_URL
    string "Default OTA URL"
    default "https://api.tenclass.net/xiaozhi/ota/"
    help
        The application will access this URL to check for new firmwares and server address.


choice
    prompt "Default Language"
    default LANGUAGE_ZH_CN
    help
        Select device display language

    config LANGUAGE_ZH_CN
        bool "Chinese"
    config LANGUAGE_ZH_TW
        bool "Chinese Traditional"
    config LANGUAGE_EN_US
        bool "English"
    config LANGUAGE_JA_JP
        bool "Japanese"
endchoice

choice BOARD_TYPE
    prompt "Board Type"
    default BOARD_TYPE_XVSENFAI
    help
        Board type. 开发板类型
    config BOARD_TYPE_LICHUANG_DEV
        bool "立创·实战派ESP32-S3开发板"
    config BOARD_TYPE_XVSENFAI
        bool "XvSenfengAI"
endchoice


config USE_WAKE_WORD_DETECT
    bool "Enable Wake Word Detection"
    default y
    depends on IDF_TARGET_ESP32S3 || IDF_TARGET_ESP32P4 && SPIRAM
    help
        需要 ESP32 S3 与 AFE 支持

config USE_AUDIO_PROCESSOR
    bool "Enable Audio Noise Reduction"
    default y
    depends on IDF_TARGET_ESP32S3 || IDF_TARGET_ESP32P4 && SPIRAM
    help
        需要 ESP32 S3 与 AFE 支持

config USE_DEVICE_AEC
    bool "Enable Device-Side AEC"
    default n
    depends on USE_AUDIO_PROCESSOR && (BOARD_TYPE_ESP_BOX_3 || BOARD_TYPE_ESP_BOX || BOARD_TYPE_ESP_BOX_LITE || BOARD_TYPE_LICHUANG_DEV || BOARD_TYPE_ESP32S3_KORVO2_V3 || BOARD_TYPE_ESP32S3_Touch_AMOLED_1_75)
    help
        因为性能不够，不建议和微信聊天界面风格同时开启

config USE_SERVER_AEC
    bool "Enable Server-Side AEC"
    default n
    depends on USE_AUDIO_PROCESSOR
    help
        启用服务器端 AEC，需要服务器支持

choice IOT_PROTOCOL
    prompt "IoT Protocol"
    default IOT_PROTOCOL_MCP
    help
        IoT 协议，用于获取设备状态与发送控制指令
    config IOT_PROTOCOL_MCP
        bool "MCP协议 2024-11-05"
endchoice

endmenu

menu "XvSenfeng Electronic Pet"
    config FREQUENCE_OF_PET
        int "宠物交互的频率,数字越大越频繁"
        default 5
    config PET_GAME_TEXT_LENG
        int "宠物游戏文本长度,数字越大越长"
        default 300

    config PET_MQTT_SERVER
        string "宠物MQTT服务器地址"
        default "mqtt.tenclass.net"
        help
            该服务器用于连接宠物设备的 MQTT 服务

    config SERVER_BASE_SERVER_URL
        string "宠物服务器地址"
        default "https://www.xvsenfeng.top"
        help
            该服务器用于连接宠物设备的 HTTP 服务
    
    config USE_OTA_UPGRADE
        bool "Enable OTA Upgrade"
        default y
        help
            启用 OTA 升级, 使用的时候需要配合ota升级项目
        
endmenu
```

## ota/main/Kconfig.projbuild
```kconfig
menu "XvSenfeng Electronic Pet"
    choice BOARD_TYPE
        prompt "Board Type"
        default BOARD_TYPE_XVSENFENGAI
        help
            Board type. 开发板类型
        config BOARD_TYPE_LICHUANG_DEV
            bool "立创·实战派ESP32-S3开发板"
        config BOARD_TYPE_XVSENFENGAI
            bool "XvSenfeng Electronic Pet"
    endchoice
endmenu
```
